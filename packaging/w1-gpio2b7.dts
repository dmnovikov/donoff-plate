// 1-Wire (w1-gpio) on GPIO2_B7 = gpiochip2 line 15, the DS18B20 of donoff.
// The line has an external pull-up. Install: /boot/overlay-user/w1-gpio2b7.dtbo + user_overlays=w1-gpio2b7.
/dts-v1/;
/plugin/;
/ {
  fragment@0 {
    target-path = "/";
    __overlay__ {
      onewire@0 {
        compatible = "w1-gpio";
        gpios = <&gpio2 15 6>; /* GPIO_ACTIVE_HIGH | GPIO_OPEN_DRAIN */
        status = "okay";
      };
    };
  };
};
